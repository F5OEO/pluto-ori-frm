## pluto-buildroot/Config.in
```kconfig
#source pluto_cc.sh
menu "SKRORG"
#	source "../../radarfrm/ad936x_ref_cal/Config.in"
#	source "../../radarfrm/libini/Config.in"
#	source "../../radarfrm/libad9361-iio/Config.in"
#	source "../../radarfrm/libosmoplutosdr/Config.in"
        source "$BR2_EXTERNAL_PLUTOSDR_PATH/package/libfec/Config.in"
	source "$BR2_EXTERNAL_PLUTOSDR_PATH/package/libtuntap/Config.in"
#	source "$BR2_EXTERNAL_PLUTOSDR_PATH/package/Config.in"
#	source "$BR2_EXTERNAL_PLUTOSDR_PATH/package/Config.in"
	source "$BR2_EXTERNAL_PLUTOSDR_PATH/package/lamableu-apps/Config.in"
	source "$BR2_EXTERNAL_PLUTOSDR_PATH/package/rtl-433/Config.in"
	source "$BR2_EXTERNAL_PLUTOSDR_PATH/package/rtlsdr-airband/Config.in"
#	source "../../radarfrm/leansdr/Config.in"
#	source "../../radarfrm/leantrx/Config.in"
        source "$BR2_EXTERNAL_PLUTOSDR_PATH/package/luaradio-basic/Config.in"
	source "$BR2_EXTERNAL_PLUTOSDR_PATH/package/multimonng/Config.in"
#	source "../../radarfrm/radarfrm/libssp/Config.in"
	source "$BR2_EXTERNAL_PLUTOSDR_PATH/package/libdvbmod/Config.in"
	source "$BR2_EXTERNAL_PLUTOSDR_PATH/package/dvb2iq/Config.in"
        source "$BR2_EXTERNAL_PLUTOSDR_PATH/package/suscan/Config.in"
	source "$BR2_EXTERNAL_PLUTOSDR_PATH/package/sigutils/Config.in"
	source "$BR2_EXTERNAL_PLUTOSDR_PATH/package/soapysdr/Config.in"
#	source "../../radarfrm/package/soapysdr-git/Config.in"
	source "$BR2_EXTERNAL_PLUTOSDR_PATH/package/soapyplutosdr/Config.in"
	source "$BR2_EXTERNAL_PLUTOSDR_PATH/package/soapyremote/Config.in"
        source "$BR2_EXTERNAL_PLUTOSDR_PATH/package/rxtools/Config.in"
	source "$BR2_EXTERNAL_PLUTOSDR_PATH/package/tx-tools/Config.in"
	source "$BR2_EXTERNAL_PLUTOSDR_PATH/package/csdr/Config.in"
	source "$BR2_EXTERNAL_PLUTOSDR_PATH/package/dump1090-pluto/Config.in"
	source "$BR2_EXTERNAL_PLUTOSDR_PATH/package/civetwebws/Config.in"
    source "$BR2_EXTERNAL_PLUTOSDR_PATH/package/soapysdr-master/Config.in"
    source "$BR2_EXTERNAL_PLUTOSDR_PATH/package/soapyplutosdr-master/Config.in"
    source "$BR2_EXTERNAL_PLUTOSDR_PATH/package/libgse/Config.in"
endmenu
```
